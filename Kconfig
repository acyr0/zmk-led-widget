## Kconfig
```kconfig
config LED_WIDGET
    bool "Enable LED widget for showing battery and output status"

if LED_WIDGET

config LED
    default y

config LED_WIDGET_INTERVAL_MS
    int "Minimum wait duration between two patterns in ms"
    default 1000

# Battery level settings

config LED_WIDGET_BATTERY_BLINK_MS
    int "Duration of battery level blink in ms"
    default 100

config LED_WIDGET_BATTERY_BLINK_SLEEP_MS
    int "Duration between battery level blink"
    default 100

# Connectivity indicator settings
config LED_WIDGET_CONN_ADVERTISING_MS
    int "Duration of BLE connection advertising blink in ms"
    default LED_WIDGET_INTERVAL_MS

config LED_WIDGET_CONN_CONNECTED_MS
    int "Duration of BLE connection advertising blink in ms"
    default 300

endif # LED_WIDGET
```
